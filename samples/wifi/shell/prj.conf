## CMakeLists.txt
```
#
# Copyright (c) 2022 Nordic Semiconductor ASA
#
# SPDX-License-Identifier: LicenseRef-Nordic-5-Clause
#

cmake_minimum_required(VERSION 3.20.0)

find_package(Zephyr REQUIRED HINTS $ENV{ZEPHYR_BASE})
project(nrf_wifi_shell)

set(WIFI_NRF_DRV_BASE ${WEST_TOPDIR}/nrf/drivers/wifi/nrf700x)
if(CONFIG_WPA_SUPP)
set(WPA_SUPP_BASE ${WEST_TOPDIR}/modules/lib/hostap)
endif()

# TODO: MbedTLS Remove this workaround
target_include_directories(mbedcrypto_common
	INTERFACE
	${CMAKE_SOURCE_DIR}
	inc
)

target_sources(app PRIVATE
	src/wifi_main.c
	src/wfa_dut_shell.c
	src/dut/wfa_sock.c
	src/dut/wfa_tg.c
	src/dut/wfa_cs.c
	src/dut/wfa_ca_resp.c
	src/dut/wfa_tlv.c
	src/dut/wfa_typestr.c
	src/dut/wfa_cmdtbl.c
	src/dut/wfa_cmdproc.c
	src/dut/wfa_miscs.c
	src/dut/wfa_thr.c
	src/dut/wfa_wmmps.c
	src/dut/wfa_dut_init.c
	src/dut/wfa_dut.c
)
```

## prj.conf
```kconfig
#
# Copyright (c) 2022 Nordic Semiconductor ASA
#
# SPDX-License-Identifier: LicenseRef-Nordic-5-Clause
#
CONFIG_WIFI=y
CONFIG_WIFI_NRF700X=y

# WPA supplicant
CONFIG_WPA_SUPP=y
CONFIG_NET_L2_WIFI_SHELL=y

# WPA_CLI
CONFIG_WPA_CLI=y

# System settings
CONFIG_NEWLIB_LIBC=y
CONFIG_NEWLIB_LIBC_NANO=n

# Networking
CONFIG_NETWORKING=y
CONFIG_NET_SOCKETS=y
CONFIG_POSIX_API=y
CONFIG_NET_LOG=y
CONFIG_NET_IPV6=y
CONFIG_NET_IPV4=y
CONFIG_NET_UDP=y
CONFIG_NET_TCP=y
CONFIG_NET_DHCPV4=y
CONFIG_DNS_RESOLVER=y
CONFIG_NET_SOCKETS_POSIX_NAMES=y
CONFIG_POSIX_FS=y
CONFIG_FILE_SYSTEM=y
CONFIG_FILE_SYSTEM_SHELL=y
CONFIG_FILE_SYSTEM_LITTLEFS=y
#CONFIG_POSIX_MAX_FDS=24

CONFIG_NET_STATISTICS=y
CONFIG_NET_STATISTICS_WIFI=y
CONFIG_NET_STATISTICS_USER_API=y

#CONFIG_NET_PKT_RX_COUNT=8
#CONFIG_NET_PKT_TX_COUNT=8

# Below section is the primary contributor to SRAM and is currently
# tuned for performance, but this will be revisited in the future.
CONFIG_NET_BUF_RX_COUNT=16
CONFIG_NET_BUF_TX_COUNT=16
CONFIG_NET_BUF_DATA_SIZE=1500
CONFIG_HEAP_MEM_POOL_SIZE=153600
CONFIG_NET_TC_TX_COUNT=1

CONFIG_NET_IF_UNICAST_IPV6_ADDR_COUNT=4
CONFIG_NET_IF_MCAST_IPV6_ADDR_COUNT=5
CONFIG_NET_MAX_CONTEXTS=16
CONFIG_NET_CONTEXT_SYNC_RECV=y

# Due to memory constraints, we need to limit the number of threads as per WFA cert tests
# Should be same as WFA_THREADS_NUM
CONFIG_MAX_PTHREAD_COUNT=4
# Every pthread_create needs a mutex, and WFA DUT needs an extra mutex/thread
# CONFIG_MAX_PTHREAD_COUNT * 2
CONFIG_MAX_PTHREAD_MUTEX_COUNT=8
# Same as above: CONFIG_MAX_PTHREAD_COUNT * 2
CONFIG_MAX_PTHREAD_COND_COUNT=8
CONFIG_INIT_STACKS=y

CONFIG_NET_L2_ETHERNET=y
CONFIG_NET_SHELL=y

CONFIG_SHELL_BACKEND_DUMMY=y
CONFIG_NET_IPV4=y
# Memories
CONFIG_MAIN_STACK_SIZE=8192
CONFIG_SHELL_STACK_SIZE=8192
CONFIG_SYSTEM_WORKQUEUE_STACK_SIZE=8192
CONFIG_NET_TX_STACK_SIZE=8192
CONFIG_NET_RX_STACK_SIZE=8192
CONFIG_SHELL_CMD_BUFF_SIZE=300

# Debugging
CONFIG_STACK_SENTINEL=y
CONFIG_DEBUG_COREDUMP=y
CONFIG_DEBUG_COREDUMP_BACKEND_LOGGING=y
CONFIG_DEBUG_COREDUMP_MEMORY_DUMP_MIN=y
CONFIG_SHELL_CMDS_RESIZE=n
#CONFIG_DEBUG=y
CONFIG_WPA_SUPP_LOG_LEVEL_INF=y

# Kernel options
CONFIG_ENTROPY_GENERATOR=y

# Logging
CONFIG_LOG=y
CONFIG_PRINTK=y
CONFIG_SHELL=y
CONFIG_SHELL_GETOPT=y
CONFIG_DEVICE_SHELL=y
CONFIG_POSIX_CLOCK=y
CONFIG_DATE_SHELL=y
CONFIG_NET_CONFIG_AUTO_INIT=n

CONFIG_WIFI_MGMT_EXT=y
CONFIG_WIFI_CREDENTIALS=y
CONFIG_WIFI_CREDENTIALS_BACKEND_SETTINGS=y
CONFIG_FLASH=y
CONFIG_FLASH_PAGE_LAYOUT=y
CONFIG_FLASH_MAP=y
CONFIG_NVS=y
CONFIG_SETTINGS=y
CONFIG_SETTINGS_NVS=y
```

## overlay-zperf.conf
```kconfig
CONFIG_NET_ZPERF=y
# Optimized networking settings for performance
CONFIG_NET_PKT_RX_COUNT=32
CONFIG_NET_PKT_TX_COUNT=32
CONFIG_NET_BUF_RX_COUNT=32
CONFIG_NET_BUF_TX_COUNT=64

CONFIG_HEAP_MEM_POOL_SIZE=160000
CONFIG_NET_BUF_DATA_SIZE=1100
CONFIG_NRF700X_QSPI_LOW_POWER=n
CONFIG_SPEED_OPTIMIZATIONS=y

# Consumes more memory
CONFIG_WIFI_CREDENTIALS=n
CONFIG_FLASH=n
CONFIG_NVS=n
CONFIG_SETTINGS=n
```

## inc/wfa_main.h
```c
/****************************************************************************
*
* Copyright (c) 2016 Wi-Fi Alliance
*
* Permission to use, copy, modify, and/or distribute this software for any
* purpose with or without fee is hereby granted, provided that the above
* copyright notice and this permission notice appear in all copies.
*
* THE SOFTWARE IS PROVIDED "AS IS" AND THE AUTHOR DISCLAIMS ALL WARRANTIES
* WITH REGARD TO THIS SOFTWARE INCLUDING ALL IMPLIED WARRANTIES OF
* MERCHANTABILITY AND FITNESS. IN NO EVENT SHALL THE AUTHOR BE LIABLE FOR ANY
* SPECIAL, DIRECT, INDIRECT, OR CONSEQUENTIAL DAMAGES OR ANY DAMAGES WHATSOEVER
* RESULTING FROM LOSS OF USE, DATA OR PROFITS, WHETHER IN AN ACTION OF CONTRACT,
* NEGLIGENCE OR OTHER TORTIOUS ACTION, ARISING OUT OF OR IN CONNECTION WITH THE
* USE OR PERFORMANCE OF THIS SOFTWARE.
*
*****************************************************************************/


#ifndef _WFA_MAIN_H
#define _WFA_MAIN_H

#ifdef WFA_PC_CONSOLE
#define WFA_MAX_TRAFFIC_STREAMS           32

/* WMM THREADS NUMBER */
#define WFA_THREADS_NUM   32
#else /* for STAION */
#define WFA_MAX_TRAFFIC_STREAMS           8

/* WMM THREADS NUMBER */
#define WFA_THREADS_NUM   8
#endif

#define MAX_CMD_BUFF        1024
#define MAX_PARMS_BUFF      1024 //IMG

#define MAX_TRAFFIC_BUF_SZ  1536

#define WFA_BUFF_32         32
#define WFA_BUFF_64         64
#define WFA_BUFF_128        128
#define WFA_BUFF_512        512
#define WFA_BUFF_1K         1024
#define WFA_BUFF_4K         4096

#ifdef WFA_PC_CONSOLE
#define WFA_RESP_BUF_SZ    WFA_BUFF_4K
#else
#define WFA_RESP_BUF_SZ    WFA_BUFF_4K
#endif

#define WFA_CMD_STR_SZ      512

enum tg_port
{
    UDP_PORT_BE1 = 0,
    UDP_PORT_BE2 = 1,
    UDP_PORT_BK1 = 2,
    UDP_PORT_BK2 = 3,
    UDP_PORT_VI1 = 4,
    UDP_PORT_VI2 = 5,
    UDP_PORT_VO1 = 6,
    UDP_PORT_VO2 = 7,
    UDP_PORT_ND1 = 8,
    UDP_PORT_ND2 = 9
};

#ifndef _WINDOWS
#define min(a,b)        ((a) < (b) ? (a) : (b))
#define max(a,b)        ((a) > (b) ? (a) : (b))

#endif
#endif
```

## inc/wfa_rsp.h
```c
/****************************************************************************
*
* Copyright (c) 2016 Wi-Fi Alliance
*
* Permission to use, copy, modify, and/or distribute this software for any
* purpose with or without fee is hereby granted, provided that the above
* copyright notice and this permission notice appear in all copies.
*
* THE SOFTWARE IS PROVIDED "AS IS" AND THE AUTHOR DISCLAIMS ALL WARRANTIES
* WITH REGARD TO THIS SOFTWARE INCLUDING ALL IMPLIED WARRANTIES OF
* MERCHANTABILITY AND FITNESS. IN NO EVENT SHALL THE AUTHOR BE LIABLE FOR ANY
* SPECIAL, DIRECT, INDIRECT, OR CONSEQUENTIAL DAMAGES OR ANY DAMAGES WHATSOEVER
* RESULTING FROM LOSS OF USE, DATA OR PROFITS, WHETHER IN AN ACTION OF CONTRACT,
* NEGLIGENCE OR OTHER TORTIOUS ACTION, ARISING OUT OF OR IN CONNECTION WITH THE
* USE OR PERFORMANCE OF THIS SOFTWARE.
*
*****************************************************************************/


#ifndef WFA_RSP_H
#define WFA_RSP_H

#include "wfa_ver.h"

#ifdef WFA_WMM_VOICE
#define WFA_INFO_BUFSIZE       128   /* used to upload test data */
#else
#define WFA_INFO_BUFSIZE       128   /* used to upload test data */
#endif

typedef struct _tg_ping_stop_resp
{
    int sendCnt;
    int repliedCnt;
} tgPingStopResp_t;

typedef struct ca_sta_get_ipconfig_resp
{
    int isDhcp;
    char ipaddr[WFA_IP_ADDR_STR_LEN];
    char mask[WFA_IP_MASK_STR_LEN];
    char dns[WFA_MAX_DNS_NUM][WFA_IP_ADDR_STR_LEN];
    char mac[WFA_MAC_ADDR_STR_LEN];

} caStaGetIpConfigResp_t;

typedef struct ca_sta_get_stats_resp
{
    int status;
    int txFrames;
    int rxFrames;
    int txMulticast;
    int rxMulticast;
    int fcsErrors ;
    int txRetries;
} caStaGetStatsResp_t;

typedef struct ca_device_get_info_resp
{
    char vendor[16];
    char model[16];
    char version[WFA_VERNAM_LEN];
    char firmware[16];
} caDeviceGetInfoResp_t;

typedef struct ca_sta_upload_resp
{
    short seqnum;
    short nbytes;
    char bytes[256];
} caStaUploadResp_t;

typedef struct ca_device_list_if_resp
{
    int status;
#define IF_80211   1
#define IF_ETH     2
    int iftype;
    char ifs[3][16];
} caDeviceListIFResp_t;

typedef struct ca_sta_cli_command_resp
{
    int status;
    short resFlag;
    char result[WFA_CLI_CMD_RESP_LEN];
} caStaCliCmdResp_t;
/* P2P */
typedef struct ca_P2p_sta_get_psk_resp
{
    char ssid[WFA_SSID_NAME_LEN];
    char passPhrase[WFA_PSK_PP_LEN];
} caP2pStaGetPskResp_t;

typedef struct ca_P2p_start_grp_form_resp
{
    char result[8];
    char grpId[WFA_P2P_GRP_ID_LEN];
} caP2pStartGrpFormResp_t;
/* P2P */

/* WFD */
typedef struct ca_sta_start_wfd_conn_resp
{
    char result[8];
    char wfdSessionId[WFA_WFD_SESSION_ID_LEN];
    char p2pGrpId[WFA_P2P_GRP_ID_LEN];
} caStaStartWfdConnResp_t;

typedef struct ca_sta_get_parameter_resp
{

    BYTE getParamType;
    char devList[128];
    char masterPref[8];
    char rssi[8];
} caStaGetParameterResp_t;

/* WFD */

/* NFC */

typedef struct ca_sta_nfc_action_resp
{
   char result[8];
   char grpId[WFA_P2P_GRP_ID_LEN];
   int peerRole;   
} caStaNfcActionResp_t;
/* NFC */

/* WFDS */

typedef struct wfds_serviceAdv_info
{
	char servName[32];
	long int advtID;
	char serviceMac[WFA_P2P_DEVID_LEN];	
} wfdsServAdvInfo_t;


typedef struct ca_sta_ConnSess_cmd_resp
{
	long int sessionID;
	char result[8];
	char grpId[WFA_P2P_GRP_ID_LEN];

} caStaConnSessCmdResp_t;



enum {
	eServiceAvilable= 0,
	eServiceNotAvailable=1,
};

typedef struct ca_sta_SearchResult_Event
{
	long int searchID;
	char serviceMac[WFA_MAC_ADDR_STR_LEN];	 
	long int advID; 
	char serviceName[32];	 
	WORD serviceStatus;
} caStaSearchResultEvent_t;

typedef struct ca_sta_SearchTerminated_Event
{
	long int searchID;
} caStaSearchTerminatedEvent_t;

enum {
	eAdvertised= 1,
	eNotAdvertised,
};

typedef struct ca_sta_AdvStatus_Event
{
	long int advID; 
	WORD status;
} caStaAdvertiseStatusEvent_t;


typedef struct ca_sta_SessionRequest_Event
{
	long int advID; 
	char sessionMac[WFA_MAC_ADDR_STR_LEN];	 
	long int sessionID;
} caStaSessionRequestEvent_t;

enum {
	eSessionStateOpen= 1,
	eSessionStateInitiated,
	eSessionStateRequested,
	eSessionStateClosed,	
};

typedef struct ca_sta_SessionStatus_Event
{
	long int sessionID; 
	char sessionMac[WFA_MAC_ADDR_STR_LEN];	 
	WORD state;
} caStaSessionStatusEvent_t;
enum {
	eNetworkRoleRejected= 1,
	eServiceRequestReceived,
	eServiceRequestDifferred,
	eServiceRequestAccepted,
	eServiceRequestFailed,
	eGroupFormationStarted,
	eGroupFormationComplete,
	eGroupFormationFailed,
};

typedef struct ca_sta_ConnectStatus_Event
{
	long int sessionID; 
	char sessionMac[WFA_MAC_ADDR_STR_LEN];	 
	WORD status;
} caStaConnectStatusEvent_t;

enum {
	eLocalPortAllowed= 1,
	eLocalPortBlocked,
	eFailure,
	eRemotePortAllowed,	
};

typedef struct ca_sta_PortStatus_Event
{
	long int sessionID; 
	char sessionMac[WFA_MAC_ADDR_STR_LEN];	 
	WORD port;
	WORD status;
} caStaPortStatusEvent_t;


typedef struct ca_sta_GetEventDetails_cmd_resp
{
	WORD eventID;
	union _EventType
	{
		caStaSearchResultEvent_t searchResult;
		caStaSearchTerminatedEvent_t searchTerminated;
		caStaAdvertiseStatusEvent_t advStatus;
		caStaSessionRequestEvent_t sessionReq;
		caStaSessionStatusEvent_t sessionStatus;
		caStaConnectStatusEvent_t connStatus;
		caStaPortStatusEvent_t portStatus;
	}getEventDetails;

} caStaGetEventDetailsCmdResp_t;


typedef struct ca_sta_GetEvents_cmd_resp
{
	char result[512];
} caStaGetEventListCmdResp_t;


typedef struct ca_sta_invoke_Seek_cmd_resp
{
	long int searchID;
} caStaInvokeSeekCmdResp_t;
typedef struct ca_sta_invoke_Advrt_cmd_resp
{
	int numServInfo;
	wfdsServAdvInfo_t servAdvInfo[5];
} caStaInvokeAdvrtCmdResp_t;

typedef struct ca_sta_invoke_cmd_resp
{
	int invokeCmdRspType;
	union _wfdsInvokeCmd
	{
		caStaInvokeAdvrtCmdResp_t advRsp;
		caStaInvokeSeekCmdResp_t seekRsp;
		caStaConnSessCmdResp_t connSessResp;

	}invokeCmdResp;
 
} caStaInvokeCmdResp_t;
/* WFDS */

typedef struct ca_sta_exec_action_resp
{
	char mac[18];
} caStaExecActionResp_t;

typedef struct ca_sta_get_events_resp
{
	char eventName[64];
	unsigned int remoteInstanceID;
	unsigned int localInstanceID;
	char mac[18];
} caStaGetEventsResp_t;

typedef struct dut_cmd_response
{
    int status;
    int streamId;
    union _cmdru
    {
        tgStats_t stats;
        tgPingStopResp_t pingStp;
        caStaGetIpConfigResp_t getIfconfig;
        caStaGetStatsResp_t ifStats;
        caDeviceGetInfoResp_t devInfo;
        caDeviceListIFResp_t ifList;
        caStaUploadResp_t  uld;
	   caStaGetEventsResp_t getEvents;
	   caStaExecActionResp_t execAction;
        char version[WFA_VERSION_LEN];
        char info[WFA_INFO_BUFSIZE];
        char bssid[WFA_MAC_ADDR_STR_LEN];
        char mac[WFA_MAC_ADDR_STR_LEN];
        /* P2P */
        char devid[WFA_P2P_DEVID_LEN];
        char grpid[WFA_P2P_GRP_ID_LEN];
        char p2presult[8];
        char wpsPin[WFA_WPS_PIN_LEN];
        caStaGetParameterResp_t getParamValue;
       int connected;
   } cmdru;
}dutCmdResponse_t;

#endif
```

## inc/wfa_sock.h
```c
/****************************************************************************
*
* Copyright (c) 2016 Wi-Fi Alliance
*
* Permission to use, copy, modify, and/or distribute this software for any
* purpose with or without fee is hereby granted, provided that the above
* copyright notice and this permission notice appear in all copies.
*
* THE SOFTWARE IS PROVIDED "AS IS" AND THE AUTHOR DISCLAIMS ALL WARRANTIES
* WITH REGARD TO THIS SOFTWARE INCLUDING ALL IMPLIED WARRANTIES OF
* MERCHANTABILITY AND FITNESS. IN NO EVENT SHALL THE AUTHOR BE LIABLE FOR ANY
* SPECIAL, DIRECT, INDIRECT, OR CONSEQUENTIAL DAMAGES OR ANY DAMAGES WHATSOEVER
* RESULTING FROM LOSS OF USE, DATA OR PROFITS, WHETHER IN AN ACTION OF CONTRACT,
* NEGLIGENCE OR OTHER TORTIOUS ACTION, ARISING OUT OF OR IN CONNECTION WITH THE
* USE OR PERFORMANCE OF THIS SOFTWARE.
*
*****************************************************************************/


#ifndef _WFA_SOCK_H
#define _WFA_SOCK_H

#include <stdio.h>		/* for printf() and fprintf() */

#ifdef _WINDOWS
#include <winsock.h>    /* for socket(), bind(), and connect() */
#else
#include <sys/socket.h> /* for socket(), bind(), and connect() */
#include <arpa/inet.h>  /* for sockaddr_in and inet_ntoa() */
#include <stdlib.h>		/* for atoi() and exit() */
#include <string.h>		/* for memset() */
#include <unistd.h>		/* for close() */
#include <sys/time.h>   /* for struct timeval {} */
#endif
#include <stdlib.h>		/* for atoi() and exit() */
#include <string.h>		/* for memset() */
#include <fcntl.h>		/* for fcntl() */
#include <errno.h>

#define MAX_UDP_LEN       1470
#define MAX_RCV_BUF_LEN   (8*1024)
//#define MAX_RCV_BUF_LEN   (32*1024)

struct sockfds
{
    int *agtfd;      /* dut agent main socket fd */
    int *cafd;       /* sock fd to control agent */
    int *tgfd;       /* traffic agent fd         */
    int *wmmfds;     /* wmm stream ids           */
    int *psfd;       /* wmm-ps socket id         */
};

extern int wfaCreateTCPServSock(unsigned short sport);
extern int wfaCreateUDPSock(char *sipaddr, unsigned short sport);
extern int wfaAcceptTCPConn(int servSock);
extern int wfaConnectUDPPeer(int sock, char *dipaddr, int dport);
extern void wfaSetSockFiDesc(zsock_fd_set *sockset, int *, struct sockfds *);
#ifdef _WINDOWS
extern int wfaCtrlSend(SOCKET sock, unsigned char *buf, int bufLen);
#else
extern int wfaCtrlSend(int sock, unsigned char *buf, int bufLen);
#endif
extern int wfaCtrlRecv(int sock, unsigned char *buf);
extern int wfaTrafficSendTo(int sock, char *buf, int bufLen, struct sockaddr *to);
extern int wfaTrafficRecv(int sock, void*, char *buf, struct sockaddr *from);
extern int wfaGetifAddr(char *ifname, struct sockaddr_in *sa);
extern struct timeval *wfaSetTimer(int, int, struct timeval *);
extern int wfaSetSockMcastRecvOpt(int, char*);
//extern int wfaSetSockMcastSendOpt(int);
extern int wfaSetProcPriority(int);

#endif /* _WFA_SOCK_H */
```

## inc/wfa_tg.h
```c
/****************************************************************************
*
* Copyright (c) 2016 Wi-Fi Alliance
*
* Permission to use, copy, modify, and/or distribute this software for any
* purpose with or without fee is hereby granted, provided that the above
* copyright notice and this permission notice appear in all copies.
*
* THE SOFTWARE IS PROVIDED "AS IS" AND THE AUTHOR DISCLAIMS ALL WARRANTIES
* WITH REGARD TO THIS SOFTWARE INCLUDING ALL IMPLIED WARRANTIES OF
* MERCHANTABILITY AND FITNESS. IN NO EVENT SHALL THE AUTHOR BE LIABLE FOR ANY
* SPECIAL, DIRECT, INDIRECT, OR CONSEQUENTIAL DAMAGES OR ANY DAMAGES WHATSOEVER
* RESULTING FROM LOSS OF USE, DATA OR PROFITS, WHETHER IN AN ACTION OF CONTRACT,
* NEGLIGENCE OR OTHER TORTIOUS ACTION, ARISING OUT OF OR IN CONNECTION WITH THE
* USE OR PERFORMANCE OF THIS SOFTWARE.
*
*****************************************************************************/


/*
 * wfa_tg.h:
 *   Definitions used in Traffic Generator Modules
 */
#ifndef _WFA_TG_H
#define _WFA_TG_H

#include <sys/time.h>
#include <pthread.h>

/* maximum number of streams to support */
#define IPV4_ADDRESS_STRING_LEN    16
#define IPV6_ADDRESS_STRING_LEN    40

#define  MINISECONDS            1000
#define  MICROSECONDS           1000000
#define  NANOSECONDS            1000000000
#define  LINUX_TIMER_RES        20000000      /* 20 MINSECONDS */
#define  CA_RESPONSE_BUF_SIZE   128

/* Limited bit rate generator related constant or threshold values defined here   */
#define WFA_SEND_FIX_BITRATE_MAX             25*1024*1024  /* 25 Mbits per sec per stream */
#define WFA_SEND_FIX_BITRATE_SLEEP_PER_SEND  1             /* mil-sec per sending sending*/

/* Profile Key words */
#define KW_PROFILE                 1
#define KW_DIRECTION               2
#define KW_DIPADDR                 3
#define KW_DPORT                   4
#define KW_SIPADDR                 5
#define KW_SPORT                   6
#define KW_FRATE                   7
#define KW_DURATION                8
#define KW_PLOAD                   9
#define KW_TCLASS                  10
#define KW_STREAMID                11
#define KW_COMPLETE                12
#define KW_ERROR                   13
#define KW_STARTDELAY              14
#define KW_NUMFRAME                15
#define KW_USESYNCCLOCK            16
#define KW_USERPRIORITY            17
#define KW_MAXCNT                  18
#define KW_TAGNAME                 19

/* Profile Types */
#define PROF_FILE_TX               1
#define PROF_MCAST                 2
#define PROF_IPTV                  3
#define PROF_TRANSC                4
#define PROF_START_SYNC            5      /* this will be outdated */
#define PROF_CALI_RTD              5
#define PROF_UAPSD                 6
#define PROF_LAST                  7

/* stream state */
#define WFA_STREAM_INACTIVE        0
#define WFA_STREAM_ACTIVE          1

/* Traffic Directions */
#define DIRECT_SEND                1
#define DIRECT_RECV                2

#define TG_PROTO_TCP               0
#define TG_PROTO_UDP               1

#define TG_WMM_AC_UP0         12     /* User Priority 0 */
#define TG_WMM_AC_UP1         13     /*               1 */
#define TG_WMM_AC_UP2         14     /*               2 */
#define TG_WMM_AC_UP3         15     /*               3 */
#define TG_WMM_AC_UP4         16     /*               4 */
#define TG_WMM_AC_UP5         17     /*               5 */
#define TG_WMM_AC_UP6         18     /*               6 */
#define TG_WMM_AC_UP7         19     /*               7 */

#define TG_WMM_AC_BE          1      /* Best Effort */
#define TG_WMM_AC_BK          2      /* Background  */
#define TG_WMM_AC_VI          3      /* Video       */
#define TG_WMM_AC_VO          4      /* Voice       */
#define TG_WMM_AC_UAPSD       5      /* UAPSD        */

#if 0
/* For wireless station, 802.11 defines 8 priority queues and 2 for each
 *  four catergories
 */
#define TG_WMM_AC_BE2       0x0a
#define TG_WMM_AC_BK2       0x0b
#define TG_WMM_AC_VI2       0x0c
#define TG_WMM_AC_VO2       0x0d
#endif

/* wmm defs */
#define TOS_VO      0xD0         // 110 1  0000 (6)  AC_VO tos/dscp values
#define TOS_VI      0xA0         // 101 0  0000 (5)  AC_VI
#define TOS_BE      0x00         // 000 0  0000 (0)  AC_BE
#define TOS_BK      0x20         // 001 0  0000 (1)  AC_BK

#define WFA_UDP_ECHO_STREAM_ID    0xFFFF
#define WFA_UDP_ECHO_PORT         07

#define WFA_PING_ICMP_ECHO         0
#define WFA_PING_UDP_ECHO          1

#define WFA_UPLOAD_VHSO_RPT        1

#define WFA_MCAST_FRATE            50       /* Multicast test rate is fixed at 50 frames/sec */

#define WFA_G_CODEC_RATE            50       /* G.729 50 pkt per second  = 20 ms interval */
#define WFA_DSCP_TABLE_SIZE         15

typedef struct _tg_stats
{
    unsigned int txFrames;
    unsigned int rxFrames;
    unsigned long long txPayloadBytes;
    unsigned long long rxPayloadBytes;
    unsigned int outOfSequenceFrames;
    unsigned int lostPkts;        /* voice over wi-fi */
    unsigned long jitter;         /* voice over wi-fi */
} tgStats_t;

typedef struct _e2e_stats
{
    int seqnum;
    int lsec;
    int lusec;
    int rsec;
    int rusec;
} tgE2EStats_t;

typedef struct _tg_profile
{
    int  profile;                           /* profile id                    */
    int  direction;
    char dipaddr[IPV4_ADDRESS_STRING_LEN];  /* destination/remote ip address */
    int  dport;
    char sipaddr[IPV4_ADDRESS_STRING_LEN];  /* source/local ip address       */
    int  sport;
    int  rate;
    int  duration;
    int  pksize;
    short trafficClass;      /* VO, VI, BK, BE */
    int  startdelay;
    int  maxcnt;
    char WmmpsTagName[10];//Aaron's//Store the test case name
} tgProfile_t;

typedef struct _tg_stream
{
    int id;
    int sockfd;
    int tblidx;
    int lastPktSN;        /* use for Jitter calculation */
    int fmInterval;
    int rxTimeLast;       /* use for pkLost             */
    int state;            /* indicate if the stream being active */
    tgProfile_t profile;
    tgStats_t stats;
} tgStream_t;

typedef struct _traffic_header
{
    char hdr[20];   /* always wfa */
} tgHeader_t;

typedef struct _tg_wmm
{
    int thr_flag;    /* this is used to indicate stream id */
    int stop_flag;    /* this is used to indicate stream id */
#ifndef _WINDOWS
    pthread_t thr;
    int thr_id;
    pthread_cond_t thr_flag_cond;
    pthread_cond_t thr_stop_cond;
    pthread_mutex_t thr_flag_mutex;
    pthread_mutex_t thr_stop_mutex;
#else
    HANDLE thr;
    DWORD thr_id;
    int timerid;
    HANDLE thr_flag_mutex;
    HANDLE thr_stop_mutex;
#endif
} tgWMM_t;

typedef int (*StationStateFunctionPtr)( char, int,int *); //PS,sleep period,state

typedef struct station_state_table
{
    StationStateFunctionPtr statefunc;
    char                    pw_offon;
    int                     sleep_period;
} StationProcStatetbl_t;

typedef int (*stationRecvStateFunctionPtr)(unsigned int *, int,int * ); //Recieved message buffer, length,state

typedef struct console_rcv_state_table
{
    stationRecvStateFunctionPtr statefunc;
} StationRecvProcStatetbl_t;

typedef struct _tg_thr_data
{
    int tid;
    StationProcStatetbl_t  *state;
    int state_num;
} tgThrData_t;

extern int wfaTGConfig(int len, BYTE *buf, int *respLen, BYTE *respBuf);
extern int wfaSendLongFile(int fromSockfd, int streamId, BYTE *respBuf, int *respLen);
extern int wfaRecvFile(int mySockfi, int profId, char *buf);
extern int wfaTGRecvStart(int len, BYTE *parms, int *respLen, BYTE *respBuf);
extern int wfaTGRecvStop(int len, BYTE *parms, int *respLen, BYTE *respBuf);
extern int wfaTGSendStart(int len, BYTE *parms, int *respLen, BYTE *respBuf);
extern int wfaTGReset(int len, BYTE *parms, int *respLen, BYTE *respBuf);
extern int wfaSendShortFile(int fromSockfd, int profId, BYTE *buf, int size, BYTE *respBuf, int *respLen);
extern int wfaFlushSockQueue(int profId);
extern int wfaTGSendPing(int len, BYTE *caCmdBuf, int *respLen, BYTE *respBuf);
extern int wfaTGStopPing(int len, BYTE *caCmdBuf, int *respLen, BYTE *respBuf);

extern int wfaSendBitrateData(int mySockfd, int streamId, BYTE *pRespBuf, int *aRespLen);
tgStream_t *findStreamProfile(int streamId);
tgProfile_t *findTGProfile(int streamId);
int convertDscpToTos(int dscp); // return >=0 as TOS, otherwise error.

#endif
```

## src/wfa_dut_shell.c
```c
/*
 * Copyright (c) 2022 Nordic Semiconductor ASA
 *
 * SPDX-License-Identifier: LicenseRef-Nordic-5-Clause
 */

/* @file
 * @brief WFA-DUT shell sample
 */

#include <stdio.h>
#include <stdlib.h>
#include <ctype.h>
#include <malloc.h>

#include <zephyr/zephyr.h>
#include <zephyr/shell/shell.h>
#include <zephyr/init.h>
#include "wfa_main.h"
#include "wfa_debug.h"
extern int dut_init;


static int cmd_wfa_dut_test(const struct shell *shell,
		size_t argc,
		const char *argv[])
{
	printf("arg0: %s\n", argv[0]);
	return dut_main(argc,
			argv);
}

unsigned char cmdBuf[WFA_BUFF_512] = {0};

static int wfa_dut_execute(const struct shell *shell,
		size_t argc,
		const char *argv[])
{	int ret;
	printf("arg0: %s\n", argv[0]);
	int status = -1;
	int i = 0;
	if(dut_init == 0)
	{
		printf("DUT is not Initialized....Initializing the DUT first\n");
		ret = shell_execute_cmd(NULL,"wfa_dut dut_test_setup wlan0 8000");
	}
#if COMMAND_BYTE_STREAM
	hex_str_to_val(cmdBuf, sizeof(cmdBuf), argv[1]);
#else
	status = cmd_to_hex(argv[1], cmdBuf);
	for (i = 0; i < 500; i++) {
		printf("%02x", cmdBuf[i]);
	}
	printf("\n");
#endif /* COMMAND_BYTE_STREAM */
	status = commandHandle(cmdBuf);
	return status;
}

SHELL_STATIC_SUBCMD_SET_CREATE(
		wfa_dut_cmds,
		SHELL_CMD(dut_test_setup,
			NULL,
			"\"Start DUT\"",
			cmd_wfa_dut_test),
		SHELL_CMD(dut_command,
			NULL,
			"\"Sets Traffic params or runs traffic\"",
			wfa_dut_execute),
		SHELL_CMD(malloc_stats,
			NULL,
			"\"Malloc debugging stats\"",
			malloc_stats),
		SHELL_SUBCMD_SET_END
		);

/* "wfa_dut" shell tool for Wi-Fi alliance certification test */
SHELL_CMD_REGISTER(wfa_dut,
		&wfa_dut_cmds,
		"wfa_dut_commands (only for internal use)",
		NULL);
```

## src/wifi_main.c
```c
/*
 * Copyright (c) 2022 Nordic Semiconductor ASA
 *
 * SPDX-License-Identifier: LicenseRef-Nordic-5-Clause
 */

/** @file
 * @brief WiFi shell sample main function
 */

#include <zephyr/sys/printk.h>
#include <nrfx_clock.h>
#include <zephyr/device.h>
#include <zephyr/net/net_config.h>

#include <zephyr/usb/usb_device.h>
#include <zephyr/net/net_config.h>


#define CONFIG_NET_CONFIG_USB_IPV4_ADDR "192.168.250.150"
int init_usb(void)
{
	int ret;

	ret = usb_enable(NULL);
	if (ret != 0) {
		printk("Cannot enable USB (%d)", ret);
		return ret;
	}

	return 0;
}
void main(void)
{
	struct in_addr addr;

#ifdef CLOCK_FEATURE_HFCLK_DIVIDE_PRESENT
	/* For now hardcode to 128MHz */
	nrfx_clock_divider_set(NRF_CLOCK_DOMAIN_HFCLK, NRF_CLOCK_HFCLK_DIV_1);
#endif
	printk("Starting %s with CPU frequency: %d MHz\n", CONFIG_BOARD, SystemCoreClock / MHZ(1));

	init_usb();

	/* Redirect static IP address to netusb*/
	const struct device *usb_dev = device_get_binding("eth_netusb");
	struct net_if *iface = net_if_lookup_by_dev(usb_dev);
	if (!iface) {
		printk("Cannot find network interface: %s", "eth_netusb");
		return;
	}
	if (sizeof(CONFIG_NET_CONFIG_USB_IPV4_ADDR) > 1) {
		if (net_addr_pton(AF_INET, CONFIG_NET_CONFIG_USB_IPV4_ADDR, &addr)) {
			printk("Invalid address: %s", CONFIG_NET_CONFIG_USB_IPV4_ADDR);
			return;
		}
		net_if_ipv4_addr_add(iface, &addr, NET_ADDR_MANUAL, 0);
	}

	if (sizeof(CONFIG_NET_CONFIG_MY_IPV4_NETMASK) > 1) {
		/* If not empty */
		if (net_addr_pton(AF_INET, CONFIG_NET_CONFIG_MY_IPV4_NETMASK, &addr)) {
			printk("Invalid netmask: %s", CONFIG_NET_CONFIG_MY_IPV4_NETMASK);
		} else {
			net_if_ipv4_set_netmask(iface, &addr);
		}
	}
	const struct device *dev = device_get_binding("wlan0");
	struct net_if *wifi_iface = net_if_lookup_by_dev(dev);
	if (!wifi_iface) {
		printk("Cannot find network interface: %s", "wlan0");
		return;
	}
	/* As both are Ethernet, we need to set specific interface*/
	net_if_set_default(wifi_iface);

	net_config_init_app(dev, "Initializing network");
}

#include <zephyr/shell/shell.h>

extern int g_num_pkts;
extern int g_count;

static int debug_rx(const struct shell *sh, size_t argc, const char *argv[])
{
	if(g_count == 0) {
		return 0;
	}

	printk("%s : %d \n", __func__, g_num_pkts / g_count);

	g_num_pkts = 0;
	g_count = 0;

	return 0;
}

SHELL_CMD_REGISTER(debug_rx, NULL, "Rx pkts per event avg.", debug_rx);
```
